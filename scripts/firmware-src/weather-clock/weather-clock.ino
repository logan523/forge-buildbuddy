// Solar Weather Clock — custom firmware for Logan's build (gift for Mia)
//
// Board: ESP32-C3 SuperMini · OLED 0.96" SSD1306 (0x3C) · SHT31 (0x44)
// SDA=GPIO4  SCL=GPIO5
//
// WHAT THIS DOES
//  1. Boot: "Connecting To Earth..." flashes on screen while Wi-Fi connects
//     and the first weather/time fetch completes.
//  2. Once real data is loaded for the first time: a one-time welcome
//     message for Mia, then it settles into the main clock.
//  3. Main screen ("blanket" view): time, date, indoor temp/humidity, and
//     outdoor weather all visible together, all the time.
//  4. Every 5 minutes: one of your messages takes over the whole screen for
//     a few seconds, word-wrapped across as many lines as it needs, then
//     back to normal.
//  5. Every hour: a special full-screen moment (Mars-and-back, a shooting
//     star, a weather-reactive scene, or — rarely — the proposal screen).
//
// EDIT HERE — your messages are down in the MESSAGES[] block below. Add as
// many as you want (no fixed limit other than the ESP32's flash size, which
// easily holds hundreds of short strings).

#include <WiFi.h>
#include <WiFiMulti.h>
#include <time.h>
#include <HTTPClient.h>
#include <Wire.h>
#include <Adafruit_GFX.h>
#include <Adafruit_SSD1306.h>
#include "Adafruit_SHT31.h"
#include <esp_system.h>  // esp_random() — hardware RNG, no seeding needed
// Generated by scripts/compile-firmware.mjs immediately before every
// compile — never committed (see .gitignore). Always compile through the
// script (`node scripts/compile-firmware.mjs --sketch scripts/firmware-src/weather-clock --key solar-weather-clock`),
// never a raw arduino-cli invocation — this file won't exist otherwise.
#include "build_id.h"
// Real bitmap fonts bundled with Adafruit_GFX (a library already in use,
// not a new dependency) — used for the main clock view instead of the
// default built-in 5x7 font. GFX fonts are baseline-anchored (the y cursor
// is the text baseline, not the top), unlike the default font.
#include <Fonts/FreeSansBold12pt7b.h>
#include <Fonts/FreeSans9pt7b.h>

// ================= EDIT HERE — Wi-Fi, location, timezone =================
// Every network here is tried; whichever is actually in range wins. Add a
// row any time the clock moves somewhere new.
// Networks live in wifi_secrets.h (gitignored) — copy wifi_secrets.example.h
// to wifi_secrets.h and fill in real values. Credentials never sit in tracked
// source; a missing file fails the compile loudly instead of leaking quietly.
#include "wifi_secrets.h"

// Tampa, FL
const float LATITUDE  = 27.9506;
const float LONGITUDE = -82.4572;

// EST. Set DAYLIGHT_OFFSET_HOURS to 0 when daylight saving ends (~Nov), back
// to 1 when it resumes (~Mar) — Florida currently observes DST.
const int GMT_OFFSET_HOURS      = -5;
const int DAYLIGHT_OFFSET_HOURS = 1;

// The one-time message Mia sees the first time the clock finishes loading
// real data after power-up (not shown again until the next power cycle).
const char* WELCOME_MESSAGE = "Hi Mia :)";

// The "will you marry me?" screen is live — it joins the same rotation as
// the other special full-screen moments (Mars-and-back, shooting star,
// weather scene), just weighted much rarer than the others (see
// PROPOSAL_ODDS below). It plays for a while, then goes back to the normal
// clock, same as the rest. Flip back to false and reflash to make it
// impossible again.
#define PROPOSAL_ELIGIBLE true

// Your rotating messages — one takes over the whole screen at random every
// ~5 minutes. Add as many as you like; long ones wrap across extra lines
// automatically.
const char* MESSAGES[] = {
  "Hi Mia! <3",
  "You, me, Buckskin Tavern?",
  "You, me, Beccofino Saturday?",
  "I MISS YOU MF",
  "Missing PopUp w/ you rn",
  "Wine walk?",
  "My HLS MVP!",
  "Guatemalaaaaaaaaa",
  "Im thinking of ur butt rn",
  "I am SO grateful for you",
  "Hot-tubbin in zion under the stars :)",
  "Thank god you got me to shave my beard",
  "Thank god you got me to get new glasses",
  "I am so frickin proud of you",
  "you got games on yo phone?",
};
const int MESSAGE_COUNT = sizeof(MESSAGES) / sizeof(MESSAGES[0]);
// ============================================================================

#define PIN_SDA 4
#define PIN_SCL 5
#define SCREEN_WIDTH 128
#define SCREEN_HEIGHT 64
#define OLED_ADDR 0x3C
Adafruit_SSD1306 display(SCREEN_WIDTH, SCREEN_HEIGHT, &Wire, -1);
Adafruit_SHT31 sht = Adafruit_SHT31();
WiFiMulti wifiMulti;

// Ease-in-out: motion starts and ends gently instead of at constant speed —
// used across the special moments (rocket flights, the flower bloom) so
// progress reads as designed motion, not a linear tween. Defined before the
// #include block below since those headers' draw functions call it.
float easeInOutQuad(float t) {
  return t < 0.5f ? 2.0f * t * t : 1.0f - (2.0f * t - 2.0f) * (2.0f * t - 2.0f) / 2.0f;
}

float g_outTemp = NAN;
String g_outText = "--";
unsigned long g_lastWeather = 0;
bool g_everLoaded = false;         // true once time+weather have both loaded at least once
bool g_wifiConfigured = false;     // true once NTP/weather have been kicked off for the current connection
unsigned long g_lastWifiRetry = 0;
const unsigned long WIFI_RETRY_INTERVAL_MS = 30000UL;  // retry Wi-Fi every 30s while disconnected
unsigned long g_lastRocketOrbit = 0;
bool g_rocketOrbitActive = false;
unsigned long g_rocketOrbitStart = 0;
const unsigned long ROCKET_ORBIT_INTERVAL_MS = 60000UL;  // every minute

// Full-screen message takeover — replaces the old corner-popup rotation.
// Every ~5 minutes one of MESSAGES[] takes the whole screen for a few
// seconds, then reverts to the normal clock.
unsigned long g_lastMessage = 0;
bool g_messageActive = false;
unsigned long g_messageStart = 0;
int g_messageIndex = 0;  // chosen fresh, once, each time a new message starts
const unsigned long MESSAGE_INTERVAL_MS = 300000UL;  // 5 minutes
const unsigned long MESSAGE_DURATION_MS = 6000UL;    // how long a message stays up

// Special full-screen moments (Mars-and-back and friends) — a rare, shared
// pool instead of Mars having its own bespoke timer. Checked on the same
// interval; when one fires, drawSpecialMoment() picks which.
unsigned long g_lastSpecialMoment = 0;
bool g_specialMomentActive = false;
unsigned long g_specialMomentStart = 0;
int g_specialMomentIndex = -1;  // which entry in SPECIAL_MOMENTS is currently playing
const unsigned long SPECIAL_MOMENT_INTERVAL_MS = 3600000UL;  // 1 hour between occurrences

#include "bitmaps.h"
#include "propose.h"
#include "mars-and-back.h"
#include "shooting-star.h"
#include "weather-scene.h"
#include "world-map.h"  // live clock face — rotating Earth + orbiting rocket

// The proposal screen is static (drawProposeScreen() takes no args) — wrap
// it to match the other moments' void(unsigned long) signature.
const unsigned long PROPOSAL_MOMENT_DURATION_MS = 15000UL;  // longer than the rest — give it room to land
void drawProposalMoment(unsigned long elapsed) { drawProposeScreen(); }

typedef void (*MomentDrawFn)(unsigned long);
struct SpecialMoment { MomentDrawFn draw; unsigned long duration; };
const SpecialMoment SPECIAL_MOMENTS[] = {
  { drawMarsAndBackMoment, MARS_MOMENT_DURATION_MS },
  { drawShootingStarMoment, STAR_MOMENT_DURATION_MS },
  { drawWeatherSceneMoment, WEATHER_SCENE_DURATION_MS },
};
const int SPECIAL_MOMENT_COUNT = sizeof(SPECIAL_MOMENTS) / sizeof(SPECIAL_MOMENTS[0]);
// 1-in-8 of all occurrences are the proposal — noticeably rarer than the 3
// regular moments, which are equally likely against each other.
const int PROPOSAL_ODDS = 8;

// Picks the next moment to play and starts it — separated from the trigger
// check in loop() so both the interval-elapsed path and (if ever wanted) a
// manual trigger can share it.
void startRandomSpecialMoment() {
  g_specialMomentActive = true;
  g_specialMomentStart = millis();
  g_lastSpecialMoment = millis();
  if (PROPOSAL_ELIGIBLE && (esp_random() % PROPOSAL_ODDS == 0)) {
    g_specialMomentIndex = -1;  // -1 marks "proposal", not an index into SPECIAL_MOMENTS
  } else {
    g_specialMomentIndex = esp_random() % SPECIAL_MOMENT_COUNT;
  }
}

void drawCurrentSpecialMoment(unsigned long elapsed) {
  if (g_specialMomentIndex == -1) drawProposalMoment(elapsed);
  else SPECIAL_MOMENTS[g_specialMomentIndex].draw(elapsed);
}

unsigned long currentSpecialMomentDuration() {
  return g_specialMomentIndex == -1 ? PROPOSAL_MOMENT_DURATION_MS : SPECIAL_MOMENTS[g_specialMomentIndex].duration;
}

// ---------------------------------------------------------------------------

// Read the numeric value for a JSON key, skipping the units section (whose
// value is a string, not a number) so we get the real reading.
float jsonNumber(String& b, const char* key) {
  int i = 0;
  while ((i = b.indexOf(key, i)) >= 0) {
    int c = b.indexOf(':', i);
    if (c < 0) return NAN;
    int j = c + 1;
    while (j < (int)b.length() && b[j] == ' ') j++;
    char ch = b[j];
    if ((ch >= '0' && ch <= '9') || ch == '-') return b.substring(j).toFloat();
    i = c + 1;
  }
  return NAN;
}

String weatherText(int code) {
  if (code == 0) return "Clear";
  if (code <= 3) return "Cloudy";
  if (code == 45 || code == 48) return "Fog";
  if (code >= 51 && code <= 67) return "Rain";
  if (code >= 71 && code <= 77) return "Snow";
  if (code >= 80 && code <= 82) return "Showers";
  if (code >= 95) return "Storm";
  return "--";
}

// Both the SHT31 library and Open-Meteo's API hand back Celsius — convert
// once here since every on-screen label says "F".
float cToF(float c) { return c * 9.0f / 5.0f + 32.0f; }

bool fetchWeather() {
  if (WiFi.status() != WL_CONNECTED) return false;
  HTTPClient http;
  String url = "http://api.open-meteo.com/v1/forecast?latitude=" + String(LATITUDE, 4) +
               "&longitude=" + String(LONGITUDE, 4) +
               "&current=temperature_2m,weather_code&timezone=auto";
  http.begin(url);
  int code = http.GET();
  bool ok = false;
  if (code == 200) {
    String body = http.getString();
    float tp = jsonNumber(body, "temperature_2m");
    float wc = jsonNumber(body, "weather_code");
    if (!isnan(tp)) { g_outTemp = cToF(tp); ok = true; }
    if (!isnan(wc)) g_outText = weatherText((int)wc);
  }
  http.end();
  return ok;
}

// Flashes "Connecting To Earth..." on/off while Wi-Fi is coming up. Runs for
// at least ~2.5s (a few visible flashes) even if Wi-Fi connects instantly,
// so it always reads as a deliberate boot sequence, not a flicker.
void bootScreen() {
  unsigned long start = millis();
  int flashes = 0;
  while (WiFi.status() != WL_CONNECTED || flashes < 3) {
    bool on = ((millis() - start) / 400) % 2 == 0;
    display.clearDisplay();
    if (on) {
      display.setTextSize(1);
      display.setCursor(10, 26);
      display.println("Connecting To Earth...");
    }
    display.display();
    if (on) flashes++;
    delay(400);
    if (millis() - start > 15000UL) break;  // don't hang forever if Wi-Fi never shows up
  }
}

// One-time welcome, shown once real data is loaded for the first time.
void welcomeScreen() {
  display.clearDisplay();
  display.setTextSize(2);
  display.setTextColor(SSD1306_WHITE);
  display.setCursor(4, 24);
  display.println(WELCOME_MESSAGE);
  display.display();
  delay(3000);
}

// Picks a fresh random message — call this exactly once, right when a new
// full-screen message starts.
void rollMessageChoice() {
  if (MESSAGE_COUNT > 0) g_messageIndex = esp_random() % MESSAGE_COUNT;
}

// Word-wraps a whole message across as many lines as it needs (up to 6 —
// far more than any real message here uses) at ~20 chars/line, the width
// the default 6px-wide font comfortably fits on a 128px screen with a
// margin. Always breaks on a word boundary; only hard-cuts a single word
// that alone overruns the line.
#define MSG_MAX_LINES 6
#define MSG_CHARS_PER_LINE 20
int wordWrapMessage(const String& msg, String outLines[MSG_MAX_LINES]) {
  int lineCount = 0;
  String cur = "";
  int start = 0;
  while (start < (int)msg.length() && lineCount < MSG_MAX_LINES - 1) {
    int sp = msg.indexOf(' ', start);
    String word = (sp < 0) ? msg.substring(start) : msg.substring(start, sp);
    String trial = cur.length() ? (cur + " " + word) : word;
    if ((int)trial.length() > MSG_CHARS_PER_LINE && cur.length() > 0) {
      outLines[lineCount++] = cur;
      cur = word;
    } else {
      cur = trial;
    }
    start = (sp < 0) ? (int)msg.length() : sp + 1;
  }
  if (cur.length() > 0 && lineCount < MSG_MAX_LINES) outLines[lineCount++] = cur;
  return lineCount;
}

// Full-screen message takeover — clears the screen, centers the wrapped
// message both vertically and horizontally. `elapsed` isn't used for
// motion (messages are static text), just kept for signature parity with
// the other full-screen moment draw functions.
void drawFullScreenMessage(unsigned long elapsed) {
  display.clearDisplay();
  display.setTextSize(1);
  display.setTextColor(SSD1306_WHITE);

  String lines[MSG_MAX_LINES];
  int lineCount = wordWrapMessage(String(MESSAGES[g_messageIndex]), lines);

  const int lineHeight = 10;
  int totalHeight = lineCount * lineHeight;
  int y = (SCREEN_HEIGHT - totalHeight) / 2;
  for (int i = 0; i < lineCount; i++) {
    int textWidth = lines[i].length() * 6;
    int x = (SCREEN_WIDTH - textWidth) / 2;
    if (x < 0) x = 0;
    display.setCursor(x, y + i * lineHeight);
    display.print(lines[i]);
  }
  display.display();
}

void setup() {
  Serial.begin(115200);
  delay(500);
  // First line printed, before anything that can stall (WiFi, display/sensor
  // init) — lets Forge's post-flash confirmation banner read this back
  // immediately and confirm the device is running the build just flashed.
  Serial.print("FORGE_BUILD_ID=");
  Serial.println(FORGE_BUILD_ID);
  Serial.println("Solar Weather Clock booting...");
  Wire.begin(PIN_SDA, PIN_SCL);

  if (!display.begin(SSD1306_SWITCHCAPVCC, OLED_ADDR)) {
    Serial.println("OLED missing — check 0x3C vs 0x3D and wiring");
  }
  display.setTextColor(SSD1306_WHITE);

  if (!sht.begin(0x44)) Serial.println("SHT3x missing at 0x44");

  WiFi.mode(WIFI_STA);
  for (int i = 0; i < WIFI_NETWORK_COUNT; i++) {
    wifiMulti.addAP(WIFI_NETWORKS[i].ssid, WIFI_NETWORKS[i].password);
  }
  wifiMulti.run();
  bootScreen();

  bool haveTime = false;
  bool haveWeather = false;
  if (WiFi.status() == WL_CONNECTED) {
    configTime(GMT_OFFSET_HOURS * 3600, DAYLIGHT_OFFSET_HOURS * 3600, "pool.ntp.org", "time.nist.gov");
    struct tm ti;
    haveTime = getLocalTime(&ti, 5000);
    haveWeather = fetchWeather();
    g_lastWeather = millis();
    g_wifiConfigured = true;
  }

  if (haveTime && haveWeather) {
    welcomeScreen();
    g_everLoaded = true;
  }
  g_lastMessage = millis();
  rollMessageChoice();
}

void loop() {
  if (g_specialMomentActive) {
    unsigned long elapsed = millis() - g_specialMomentStart;
    if (elapsed >= currentSpecialMomentDuration()) {
      g_specialMomentActive = false;  // falls through to the normal clock below
    } else {
      drawCurrentSpecialMoment(elapsed);
      delay(200);
      return;
    }
  } else if (millis() - g_lastSpecialMoment > SPECIAL_MOMENT_INTERVAL_MS) {
    startRandomSpecialMoment();
    drawCurrentSpecialMoment(0);
    delay(200);
    return;
  }

  // --- Full-screen message, every 5 minutes ---
  if (g_messageActive) {
    unsigned long elapsed = millis() - g_messageStart;
    if (elapsed >= MESSAGE_DURATION_MS) {
      g_messageActive = false;  // falls through to the normal clock below
    } else {
      drawFullScreenMessage(elapsed);
      delay(200);
      return;
    }
  } else if (MESSAGE_COUNT > 0 && millis() - g_lastMessage > MESSAGE_INTERVAL_MS) {
    g_lastMessage = millis();
    g_messageActive = true;
    g_messageStart = millis();
    rollMessageChoice();
    drawFullScreenMessage(0);
    delay(200);
    return;
  }

  // --- Wi-Fi watchdog: setup() only calls WiFi.begin() once. If that
  // connection attempt failed or later drops, nothing else ever retries —
  // this is what "stuck syncing forever" actually was. Retry periodically,
  // and catch up on time + weather the moment a connection lands.
  if (WiFi.status() != WL_CONNECTED) {
    g_wifiConfigured = false;
    if (millis() - g_lastWifiRetry > WIFI_RETRY_INTERVAL_MS) {
      g_lastWifiRetry = millis();
      wifiMulti.run();
    }
  } else if (!g_wifiConfigured) {
    configTime(GMT_OFFSET_HOURS * 3600, DAYLIGHT_OFFSET_HOURS * 3600, "pool.ntp.org", "time.nist.gov");
    fetchWeather();
    g_lastWeather = millis();
    g_wifiConfigured = true;
  }

  float t = cToF(sht.readTemperature());
  float h = sht.readHumidity();

  struct tm timeinfo;
  bool haveTime = getLocalTime(&timeinfo, 50);

  if (millis() - g_lastWeather > 900000UL) { fetchWeather(); g_lastWeather = millis(); }

  // Data finished loading for the first time after a boot that skipped the
  // welcome screen above (e.g. NTP/weather took a moment longer than the
  // initial fetch window) — show it once, the moment it's actually ready.
  if (!g_everLoaded && haveTime && !isnan(g_outTemp)) {
    welcomeScreen();
    g_everLoaded = true;
    g_lastMessage = millis();
  }

  display.clearDisplay();

  // --- Blanket view: everything, all the time ---
  display.setTextSize(1);
  char buf[8] = "";
  char dbuf[20] = "";
  const char* ampm = "";
  if (haveTime) {
    // 12-hour, no leading zero (e.g. "2:32" not "14:32") — strftime's %I
    // always zero-pads, so this is built by hand instead.
    int hour12 = timeinfo.tm_hour % 12;
    if (hour12 == 0) hour12 = 12;
    snprintf(buf, sizeof(buf), "%d:%02d", hour12, timeinfo.tm_min);
    ampm = (timeinfo.tm_hour < 12) ? "AM" : "PM";
    strftime(dbuf, sizeof(dbuf), "%a %b %d", &timeinfo);
  }
  drawWorldMapClockFace(haveTime, buf, dbuf, ampm, t, h, g_outTemp, g_outText);
  // Every other screen (full-screen messages, special moments, boot/welcome)
  // assumes the default built-in font's metrics — drawWorldMapClockFace
  // already resets this, but stay explicit here too.
  display.setFont(NULL);

  // --- Rocket orbiting the globe, every minute ---
  if (millis() - g_lastRocketOrbit > ROCKET_ORBIT_INTERVAL_MS) {
    g_lastRocketOrbit = millis();
    g_rocketOrbitStart = millis();
    g_rocketOrbitActive = true;
  }
  if (g_rocketOrbitActive) {
    unsigned long orbitElapsed = millis() - g_rocketOrbitStart;
    if (orbitElapsed >= ROCKET_ORBIT_DURATION_MS) g_rocketOrbitActive = false;
    else drawRocketOrbit(orbitElapsed);
  }

  display.display();
  delay(200);
}
